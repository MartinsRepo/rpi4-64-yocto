## meta-add-solibs/conf/layer.conf
```bitbake
# We have a conf and classes directory, add to BBPATH
BBPATH .= ":${LAYERDIR}"

# We have recipes-* directories, add to BBFILES
BBFILES += "${LAYERDIR}/recipes-*/*/*.bb \
            ${LAYERDIR}/recipes-*/*/*.bbappend"

BBFILE_COLLECTIONS += "meta-add-solibs"
BBFILE_PATTERN_meta-add-solibs = "^${LAYERDIR}/"
BBFILE_PRIORITY_meta-add-solibs = "6"

LAYERDEPENDS_meta-add-solibs = "core"
LAYERSERIES_COMPAT_meta-add-solibs = "kirkstone"

#EXTRA_OECONF += "--enable-static --enable-shared"
#TOOLCHAIN_TARGET_TASK:append = " add-alibs-staticdev add-alibs-dev"
```

## meta-algo/conf/layer.conf
```bitbake
# We have a conf and classes directory, add to BBPATH
BBPATH .= ":${LAYERDIR}"

# We have recipes-* directories, add to BBFILES
BBFILES += "${LAYERDIR}/recipes-*/*/*.bb \
            ${LAYERDIR}/recipes-*/*/*.bbappend"

BBFILE_COLLECTIONS += "meta-algo"
BBFILE_PATTERN_meta-algo = "^${LAYERDIR}/"
BBFILE_PRIORITY_meta-algo = "6"

LAYERDEPENDS_meta-algo = "core"
LAYERSERIES_COMPAT_meta-algo = "kirkstone langdale"
```

## meta-cfgip/conf/layer.conf
```bitbake
# We have a conf and classes directory, add to BBPATH
BBPATH .= ":${LAYERDIR}"

# We have recipes-* directories, add to BBFILES
BBFILES += "${LAYERDIR}/recipes-*/*/*.bb \
            ${LAYERDIR}/recipes-*/*/*.bbappend"

BBFILE_COLLECTIONS += "meta-cfgip"
BBFILE_PATTERN_meta-cfgip = "^${LAYERDIR}/"
BBFILE_PRIORITY_meta-cfgip = "6"

LAYERDEPENDS_meta-cfgip = "core"
LAYERSERIES_COMPAT_meta-cfgip = "kirkstone langdale"
```

## meta-swsysalgo/conf/layer.conf
```bitbake
# We have a conf and classes directory, add to BBPATH
BBPATH .= ":${LAYERDIR}"

# We have recipes-* directories, add to BBFILES
BBFILES += "${LAYERDIR}/recipes-*/*/*.bb \
            ${LAYERDIR}/recipes-*/*/*.bbappend"

BBFILE_COLLECTIONS += "meta-swsysalgo"
BBFILE_PATTERN_meta-swsysalgo = "^${LAYERDIR}/"
BBFILE_PRIORITY_meta-swsysalgo = "6"

LAYERDEPENDS_meta-swsysalgo = "core"
LAYERSERIES_COMPAT_meta-swsysalgo = "kirkstone langdale"
```
